## boards/nice_nano_v2.conf
```kconfig
# Nice!Nano v2 specific configuration
# nRF52840 SoC with built-in USB and Bluetooth LE

# Enable SPI for potential RGB underglow
CONFIG_SPI=y

# Bluetooth and power optimization for wireless operation
CONFIG_ZMK_SLEEP=y

# USB support (Nice!Nano has native USB)
CONFIG_ZMK_USB=y
```

## boards/shields/skreecustom/Kconfig.defconfig
```kconfig
if SHIELD_SKREECUSTOM_DONGLE

config ZMK_KEYBOARD_NAME
    default "Skree"

config ZMK_SPLIT_ROLE_CENTRAL
    default y

config ZMK_STUDIO
    default y

endif

if SHIELD_SKREECUSTOM_LEFT

config ZMK_KEYBOARD_NAME
    default "Skree L"

endif

if SHIELD_SKREECUSTOM_RIGHT

config ZMK_KEYBOARD_NAME
    default "Skree R"

endif

if SHIELD_SKREECUSTOM_DONGLE || SHIELD_SKREECUSTOM_LEFT || SHIELD_SKREECUSTOM_RIGHT

config ZMK_SPLIT
    default y

endif
```

## boards/shields/skreecustom/Kconfig.shield
```kconfig
# No whitespace after the comma or in your part name!
config SHIELD_SKREECUSTOM_DONGLE
    def_bool $(shields_list_contains,skreecustom_dongle)

config SHIELD_SKREECUSTOM_LEFT
    def_bool $(shields_list_contains,skreecustom_left)

config SHIELD_SKREECUSTOM_RIGHT
    def_bool $(shields_list_contains,skreecustom_right)
```
