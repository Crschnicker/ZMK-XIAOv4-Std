#include "skreecustom.dtsi"

// Dongle acts as central - no physical matrix, but needs to define kscan for split
&kscan0 {
    // Dongle has no physical keys, but needs col-gpios defined for ZMK requirement
    col-gpios = <&gpio0 2 GPIO_ACTIVE_HIGH>;  // Dummy pin, not actually used
};