#include "skreecustom.dtsi"

&kscan0 {
    col-gpios           // Left half column pins for Nice!Nano
        = <&gpio1 6 GPIO_ACTIVE_HIGH>   // P1.06
        , <&gpio1 4 GPIO_ACTIVE_HIGH>   // P1.04  
        , <&gpio0 11 GPIO_ACTIVE_HIGH>  // P0.11
        , <&gpio1 0 GPIO_ACTIVE_HIGH>   // P1.00
        , <&gpio0 24 GPIO_ACTIVE_HIGH>  // P0.24
        , <&gpio0 22 GPIO_ACTIVE_HIGH>  // P0.22
        ;
};